## drivers/input/touchscreen/fts_spi/Kconfig
```kconfig
config TOUCHSCREEN_ST_FTS_V521_SPI
	tristate "ST FTS V521 I2C Touchscreen"
	depends on SPI_MASTER
	select REGMAP_SPI
	help
	  Say Y here if you have ST FTS series I2C touchscreen.
	  If unsure, say N.
	  To compile this driver as a module, choose M here
```

## drivers/input/touchscreen/fts_spi_basic/Kconfig
```kconfig
# SPDX-License-Identifier: GPL-2.0-only

config TOUCHSCREEN_ST_FTS_V521_SPI_BASIC
tristate "ST FTS V521 SPI touchscreen (basic)"
depends on SPI_MASTER
depends on OF
help
  Say Y here if you have a device with an ST FTS touchscreen
  connected over SPI and only need basic multitouch reporting.

  To compile this driver as a module, choose M here: the
  module will be called fts_touch_spi_basic.
```
